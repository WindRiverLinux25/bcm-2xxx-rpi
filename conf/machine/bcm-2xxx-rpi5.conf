## conf/machine/bcm-2xxx-rpi5.conf
```bitbake
#@TYPE: Machine
#@NAME: bcm-2xxx-rpi.inc
#@DESCRIPTION: Machine configuration for running a bcm-2xxx-rpi

require bcm-2xxx-rpi.inc
require rpi-graphics.inc

MACHINE_FEATURES += "pci"

EX_KERNEL_DEVICETREE ?= "broadcom/bcm2710-rpi-3-b.dtb broadcom/bcm2710-rpi-3-b-plus.dtb"

KERNEL_DEVICETREE = "broadcom/bcm2712-rpi-5-b.dtb ${EX_KERNEL_DEVICETREE} ${RPI_KERNEL_DEVICETREE_OVERLAYS}"

SDIMG_KERNELIMAGE ?= "kernel_2712.img"
```

## conf/machine/rpi-graphics.inc
```bitbake
MACHINE_FEATURES:append:rpi = " vc4graphics"

XSERVER = " \
    xserver-xorg \
    ${@bb.utils.contains("MACHINE_FEATURES", "vc4graphics", "xserver-xorg-extension-glx", "", d)} \
    ${@bb.utils.contains("MACHINE_FEATURES", "vc4graphics", "xf86-video-modesetting", "xf86-video-fbdev", d)} \
"

WRL_RECIPES:openembedded-layer += 'libmms'

PREFERRED_PROVIDER_virtual/egl = "${@bb.utils.contains("MACHINE_FEATURES", "vc4graphics", "mesa", "userland", d)}"
PREFERRED_PROVIDER_virtual/libgles2 = "${@bb.utils.contains("MACHINE_FEATURES", "vc4graphics", "mesa", "userland", d)}"
PREFERRED_PROVIDER_virtual/libgl = "${@bb.utils.contains("MACHINE_FEATURES", "vc4graphics", "mesa", "mesa-gl", d)}"
PREFERRED_PROVIDER_virtual/mesa = "${@bb.utils.contains("MACHINE_FEATURES", "vc4graphics", "mesa", "mesa-gl", d)}"
PREFERRED_PROVIDER_virtual/libgbm = "${@bb.utils.contains("MACHINE_FEATURES", "vc4graphics", "mesa", "mesa-gl", d)}"
```
